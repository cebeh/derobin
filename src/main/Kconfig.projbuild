## src/main/Kconfig.projbuild
```kconfig
menu "DeRobin Application"

config VOICE_DIR
    string "Voice directory"
    default "/recources/voice"
    help
        files for the voices

config AMBIENCE_DIR
    string "Ambience directory"
    default "/recources/ambience"
    help
        files for the ambiences music

config NOTIFICATION_DIR
    string "Notifications directory"
    default "/recources/notification"
    help
        files for the notifications 


config WIFI_SSID
    string "WiFi SSID"
    default "myssid"
    help
        SSID (network name) for the example to connect to.

config WIFI_PASSWORD
    string "WiFi Password"
    default "mypassword"
    help
        WiFi password (WPA or WPA2) for the example to use.

config EMITTER_CHANNEL_KEY
    string "Emitter channel key"
    default ""
    help
        The Emitter channel key using to pub/sub


endmenu
```
